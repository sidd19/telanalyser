
/*
  Generate a low-quality dial tone on a digital pin.
  Copyright 2016 Pete El_Supremo
*/

// Piezo buzzer pin, but an 8-ohm speaker will give somewhat
// better quality sound.
// Use a 22ohm resistor from this pin to the piezo/speaker
int piezoPin = 4;

// The tone will stop playing while this pin is grounded.
// Or the code can be modified to terminate the tone when
// the pin is grounded.
int stopPin = 5;


// Times of zero crossing when sampled at 8000Hz
// therefore multiply each one by 125 microseconds
// to get its cumulative elapsed time.

uint16_t tone_zeroes[] = {
//#define TONES_1
#ifdef TONES_1
      10,
      20,
      30,
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     992,
#else
      10,
      20,
      30,
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    3999,
#endif
};

void setup()  
{
  Serial.begin(9600);
  while(!Serial);
  delay(2000);
  
  pinMode(piezoPin, OUTPUT);
  pinMode(stopPin, INPUT_PULLUP);
  // Initialize the tone_zeroes array
  for(int i = sizeof(tone_zeroes)/sizeof(tone_zeroes[0])-1;i > 0 ;i--) 
  {
    tone_zeroes[i] = tone_zeroes[i] - tone_zeroes[i-1];
//Serial.println(tone_zeroes[i]);
  }
  
  play_dial();
}      

void loop()
{

}      

// Play the dial tone
void play_dial (void)
{

  int idx = 0;
  int output = 0;
  unsigned long delayCount;    
  while(1) {
    output ^= 1;
    delayCount = tone_zeroes[idx++];
    digitalWrite(piezoPin,output);
    delayMicroseconds(delayCount*125L);
    if (idx >= sizeof(tone_zeroes)/sizeof(tone_zeroes[0]))idx = 0;
    // This hangs the code if stopPin is grounded.
    // Or it can be used to terminate the tone and return from the
    // function by adding "break" to the while loop.
    while(digitalRead(stopPin) == 0);
  }  
  digitalWrite(piezoPin, LOW);
}      
